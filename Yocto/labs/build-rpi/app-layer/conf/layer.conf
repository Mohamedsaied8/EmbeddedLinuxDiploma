## Yocto/labs/build-rpi/app-layer/conf/layer.conf
```bitbake
# We have a conf and classes directory, add to BBPATH
BBPATH .= ":${LAYERDIR}"

# We have recipes-* directories, add to BBFILES
BBFILES += "${LAYERDIR}/recipes-*/*/*.bb \
            ${LAYERDIR}/recipes-*/*/*.bbappend"

BBFILE_COLLECTIONS += "app-layer"
BBFILE_PATTERN_app-layer = "^${LAYERDIR}/"
BBFILE_PRIORITY_app-layer = "6"

LAYERDEPENDS_app-layer = "core"
LAYERSERIES_COMPAT_app-layer = "nanbield"
```

## Yocto/labs/build-rpi/conf/bblayers.conf
```bitbake
# POKY_BBLAYERS_CONF_VERSION is increased each time build/conf/bblayers.conf
# changes incompatibly
POKY_BBLAYERS_CONF_VERSION = "2"

BBPATH = "${TOPDIR}"
BBFILES ?= ""

BBLAYERS ?= " \
  /home/mohamed/Desktop/yocto/poky/meta \
  /home/mohamed/Desktop/yocto/poky/meta-poky \
  /home/mohamed/Desktop/yocto/poky/meta-yocto-bsp \
  /home/mohamed/Desktop/yocto/poky/build-rpi/my-layer \
  /home/mohamed/Desktop/yocto/poky/build-rpi/app-layer \
  "
```
